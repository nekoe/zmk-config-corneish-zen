## config/west.yml
```yaml
manifest:
  remotes:
    - name: zmkfirmware
      url-base: https://github.com/zmkfirmware
    - name: caksoylar
      url-base: https://github.com/caksoylar
  projects:
    - name: zmk
      remote: caksoylar #zmkfirmware
      revision: caksoylar/zen-v1+v2 #main
      import: app/west.yml
  self:
    path: config
```
